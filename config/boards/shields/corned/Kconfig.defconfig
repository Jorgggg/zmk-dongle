## config/boards/shields/corned/Kconfig.defconfig
```kconfig
# Copyright (c) 2020 The ZMK Contributors
# SPDX-License-Identifier: MIT

if SHIELD_CORNED_DONGLE

config ZMK_KEYBOARD_NAME
	default "Corne Dongle"
	
config ZMK_SPLIT_BLE_ROLE_CENTRAL
	default y
	
config ZMK_USB
	default y

endif

#if ZMK_DISPLAY
#
#config I2C
#	default y
#config SSD1306
#	default y
#endif 
#
if SHIELD_CORNED_LEFT || SHIELD_CORNED_RIGHT || SHIELD_CORNED_DONGLE 

config ZMK_SPLIT
	default y

config ZMK_BLE
	default y
	
endif
```
